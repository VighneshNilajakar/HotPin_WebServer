## hotpin-firmware/main/Kconfig.projbuild
```kconfig
# HotPin Firmware Configuration

menu "HotPin Configuration"

config HOTPIN_WS_URL
    string "WebSocket Server URL"
    default "ws://10.50.92.58:8000/ws "
    help
      WebSocket URL for the HotPin server

config HOTPIN_WS_TOKEN
    string "WebSocket Authentication Token"
    default "mysecrettoken123"
    help
      Authentication token for WebSocket connection

config ESP_WIFI_SSID
    string "WiFi SSID"
    default ""
    help
      WiFi network name to connect to (leave empty to disable WiFi)

config ESP_WIFI_PASSWORD
    string "WiFi Password"
    default ""
    help
      WiFi network password (leave empty for open networks)

config CAMERA_MODEL_AI_THINKER
    bool "AI-Thinker ESP-CAM Module"
    default y
    help
      Enable support for AI-Thinker ESP-CAM module with OV2640 camera

endmenu
```

## hotpin-firmware/sdkconfig.defaults
```kconfig
# HotPin Firmware Default Configuration

# Enable PSRAM support
CONFIG_SPIRAM=y
CONFIG_SPIRAM_USE_CAPS_ALLOC=y
CONFIG_SPIRAM_USE_MALLOC=y

# Enable camera support
CONFIG_CAMERA_MODEL_AI_THINKER=y

# Enable WebSocket client - Use correct component names
CONFIG_ESP_WEBSOCKET_CLIENT_ENABLED=y

# Enable HTTP client for image uploads
CONFIG_ESP_HTTP_CLIENT_ENABLED=y

# Enable I2S driver
CONFIG_I2S_ENABLED=y

# WiFi config
CONFIG_ESP_WIFI_ENABLED=y
CONFIG_ESP_WIFI_STA_ENABLED=y

# Enable cJSON
CONFIG_ESP_SYSTEM_USE_CJSON=y

# Memory and performance
CONFIG_FREERTOS_UNICORE=n
CONFIG_ESP_DEFAULT_CPU_FREQ_MHZ_240=y

# Disable brownout detector to prevent unexpected resets
CONFIG_ESP_BROWNOUT_DET=n

# Suppress legacy driver deprecated warnings
CONFIG_I2S_SUPPRESS_LEGACY_WARNINGS=y
CONFIG_ADC_SUPPRESS_LEGACY_WARNINGS=y

# Additional power management settings
CONFIG_ESP_WIFI_MAX_TX_POWER=78 # Reduce WiFi transmission power (in 0.25dBm units, 78 = 19.5dBm -> effectively 8dBm)
```
